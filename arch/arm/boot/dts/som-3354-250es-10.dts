/*
 * som-3354-250es-7.dts - Device Tree file for the SOM-3354M with SOM-250ES
 *                        w/ 7 inch display
 *
 * Copyright (C) 2015 EMAC Inc.
 * Copyright (C) 2015 QWERTY Embedded Design
 *
 * This program is free software; you can redistribute it and/or modify
 * it under the terms of the GNU General Public License version 2 as
 * published by the Free Software Foundation.
 */

#include "som-3354-250es-7.dts"

/ {
	model = "EMAC SOM-3354M SOM-250ES-10";

	panel {
		display-timings {
			native-mode = <&timing2>;
			timing2: 1024x600 {
				hactive		= <1024>;
				vactive		= <600>;
				hback-porch     = <160>;
				hfront-porch    = <24>;
				hsync-len       = <136>;
				vback-porch     = <23>;
				vfront-porch    = <1>;
				vsync-len       = <4>;
				clock-frequency = <45000000>;
				hsync-active    = <0>;
				vsync-active    = <0>;
				de-active = <1>;
				pixelclk-active = <1>;
			};
		};
	};
};
